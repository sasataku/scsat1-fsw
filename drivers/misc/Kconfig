## drivers/misc/Kconfig
```kconfig
# Copyright (c) 2024 Space Cubics, LLC.
# SPDX-License-Identifier: Apache-2.0

menu "SC-Sat1 Miscellaneous Drivers"

rsource "dstrx3/Kconfig"

endmenu
```

## lib/flash/Kconfig
```kconfig
# Copyright (c) 2024 Space Cubics, LLC.
# SPDX-License-Identifier: Apache-2.0

menuconfig SC_LIB_FLASH
	bool "Space Cubics Flash Memory libraries"
	default y
	help
	  Enable Space Cubics Flash Memory libraries.
```

## tests/hwtest/main/Kconfig
```kconfig
mainmenu "SC-Sat1 Main Board"

menu "Application"

config SCSAT1_MAIN_AUTO_RUN_HWTEST
	bool "Enable auto run for HW test"
	default n
	help
	  Enable auto run for HW test.

config SCSAT1_MAIN_CAP_INTERVAL_SEC
	int "Interval (seconds) of capture frame command"
	default 60
	help
	  Interval (seconds) of capture frame command

choice
	prompt "Magnet Meter device type"
	default SCSAT1_MGNM_DEV_TYPE_MMC5883MA

config SCSAT1_MGNM_DEV_TYPE_MMC5883MA
	bool "Magnet Meter MMC5883MA"
	help
	  Magnet Meter MMC5883MA for SC-Sat1 FM

config SCSAT1_MGNM_DEV_TYPE_MMC5983MA
	bool "Magnet Meter MMC5983MA"
	help
	  Magnet Meter MMC5983MA for SC-Sat1 EM

endchoice

endmenu

menu "Zephyr"
source "Kconfig.zephyr"
endmenu
```

## west.yml
```yaml
manifest:

  projects:
    - name: zephyr
      url: https://github.com/zephyrproject-rtos/zephyr
      revision: v3.6.0
      path: zephyr
      west-commands: scripts/west-commands.yml
      import:
        name-allowlist:
          - cmsis
          - picolibc

    - name: libcsp
      url: https://github.com/libcsp/libcsp.git
      revision: 0d5e91b297445bcf3531ec370e246933c94445f1
      path: modules/lib/libcsp
```
